/*
  Starbie: a tiny motion-controlled digital pet

  This is intentionally one file. Open this .ino file in Arduino IDE, edit
  the BEGINNER SETTINGS section, and upload it to a Seeed XIAO ESP32-C3.

  Install these libraries with Sketch > Include Library > Manage Libraries:
    - Adafruit GFX Library
    - Adafruit SSD1306
    - Adafruit MPU6050
    - DHT sensor library
  Arduino IDE will offer to install their dependencies too. Click Install All.
*/

#include <Wire.h>
#include <Adafruit_GFX.h>
#include <Adafruit_SSD1306.h>
#include <Adafruit_MPU6050.h>
#include <DHT.h>
#include <Preferences.h>
#include <math.h>

// =========================== BEGINNER SETTINGS ===========================
// Everything most builders will want to customize is in this one section.

// --- Your board's pins ----------------------------------------------------
// These are ESP32-C3 GPIO numbers, with the XIAO pin labels beside them.
const int I2C_SDA_PIN = 7;       // XIAO D4: OLED + MPU6050 SDA
const int I2C_SCL_PIN = 6;       // XIAO D5: OLED + MPU6050 SCL
const int DHT_PIN = 3;           // XIAO D1: DHT11 data
const int BUTTON_ONE_PIN = 4;    // XIAO D2: opens/confirms the radial menu
const int BUTTON_TWO_PIN = 5;    // XIAO D3: shows/hides stats

// Set this to false if your submission does not have a DHT11.
const bool USE_DHT11 = true;

// Most parts use these addresses. Only change them if an I2C scanner says
// your part is different (common OLED alternative: 0x3D).
const uint8_t OLED_ADDRESS = 0x3C;
const uint8_t MPU6050_ADDRESS = 0x68;


// ======================== GAME SETTINGS ===================================

const bool isPlayingDemo = true;

const uint8_t PROGMEM Blobb[] = {
  0x00, 0x00, 0x00, 0x00, 0x00, 0x00, 0x00, 0x00, 0x00, 0x00, 0x00, 0x00, 0x00, 0x00, 0x00, 0x00, 
	0x00, 0x00, 0x00, 0x00, 0x00, 0x00, 0x00, 0x00, 0x00, 0x00, 0x00, 0x00, 0x00, 0x00, 0x00, 0x00, 
	0x00, 0x00, 0x00, 0x00, 0x00, 0x00, 0x00, 0x00, 0x00, 0x03, 0xff, 0x00, 0x00, 0x1c, 0x01, 0x80, 
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	0x07, 0xff, 0xfe, 0x00, 0x00, 0x00, 0x00, 0x00, 0x00, 0x00, 0x00, 0x00, 0x00, 0x00, 0x00, 0x00
};

const uint8_t PROGMEM Blocky_Evo1[] = {
  0x00, 0x00, 0x00, 0x00, 0x00, 0x00, 0x00, 0x00, 0x00, 0x00, 0x00, 0x00, 0x00, 0x00, 0x00, 0x00, 
	0x00, 0x00, 0x00, 0x00, 0x00, 0x00, 0x00, 0x00, 0x00, 0x00, 0x00, 0x00, 0x00, 0x00, 0x00, 0x00, 
	0x00, 0x07, 0xc0, 0x00, 0x00, 0x04, 0x60, 0x00, 0x00, 0x04, 0x20, 0x00, 0x00, 0x0c, 0x20, 0x00, 
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	0x1f, 0xff, 0xff, 0xf8, 0x00, 0x00, 0x00, 0x00, 0x00, 0x00, 0x00, 0x00, 0x00, 0x00, 0x00, 0x00
};

const uint8_t PROGMEM Blocky_Evo2[] = {
  0x00, 0x00, 0x00, 0x00, 0x00, 0x00, 0x00, 0x00, 0x00, 0x00, 0x00, 0x00, 0x00, 0x00, 0x00, 0x00, 
	0x00, 0x7f, 0xfc, 0x00, 0x00, 0x40, 0x04, 0x00, 0x00, 0x44, 0x44, 0x00, 0x00, 0x64, 0x44, 0x00, 
	0x00, 0x30, 0x18, 0x00, 0x00, 0x10, 0x10, 0x00, 0x00, 0x10, 0x10, 0x00, 0x00, 0x10, 0x10, 0x00, 
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	0x1f, 0xff, 0xff, 0xf8, 0x00, 0x00, 0x00, 0x00, 0x00, 0x00, 0x00, 0x00, 0x00, 0x00, 0x00, 0x00
};

const uint8_t PROGMEM Blocky_Evo3[] = {
  0x00, 0x21, 0x08, 0x00, 0x20, 0x00, 0x01, 0x02, 0x02, 0x3f, 0xff, 0x88, 0x08, 0xc0, 0x00, 0x82, 
	0x00, 0xc0, 0x03, 0xa0, 0x40, 0x4c, 0x1a, 0x06, 0x08, 0x42, 0x22, 0x0e, 0x01, 0x62, 0x22, 0x1c, 
	0x00, 0x22, 0x23, 0x3c, 0x00, 0xb8, 0x00, 0xf0, 0x20, 0x08, 0x00, 0xe1, 0x00, 0xc8, 0x00, 0xc4, 
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	0x08, 0x00, 0x00, 0x0c, 0x0f, 0xff, 0xff, 0xf8, 0x00, 0x00, 0x00, 0x00, 0x00, 0x00, 0x00, 0x00
};

const uint8_t PROGMEM Spiky_Evo1[] = {
  0x00, 0x00, 0x00, 0x00, 0x00, 0x00, 0x00, 0x00, 0x00, 0x00, 0x00, 0x00, 0x00, 0x00, 0x00, 0x00, 
	0x00, 0x00, 0x00, 0x00, 0x00, 0x00, 0x00, 0x00, 0x00, 0x38, 0x00, 0x00, 0x00, 0x2e, 0x0c, 0x00, 
	0x00, 0x21, 0x1e, 0x00, 0x00, 0x20, 0x92, 0x00, 0x0e, 0x40, 0x63, 0x00, 0x09, 0x40, 0x01, 0xf0, 
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	0x0b, 0x8e, 0xc4, 0x88, 0x0c, 0xf1, 0x83, 0x00, 0x00, 0x00, 0x00, 0x00, 0x00, 0x00, 0x00, 0x00
};

const uint8_t PROGMEM Spiky_Evo2[] = {
  0x00, 0x00, 0x00, 0x00, 0x00, 0x03, 0x00, 0x00, 0x01, 0x03, 0xb0, 0x0c, 0x01, 0x06, 0xf8, 0x38, 
	0x01, 0xcc, 0xce, 0xe8, 0x01, 0x38, 0x03, 0xc8, 0x71, 0x10, 0x00, 0x48, 0x5f, 0x00, 0x00, 0x68, 
	0x68, 0x1c, 0x03, 0x38, 0x3c, 0x1e, 0x07, 0xb0, 0x0e, 0x1f, 0x07, 0x88, 0x02, 0x1f, 0x07, 0x88, 
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	0x01, 0x41, 0xef, 0xe8, 0x01, 0xbf, 0xf0, 0x38, 0x00, 0x20, 0x00, 0x00, 0x00, 0x00, 0x00, 0x00
};

const uint8_t PROGMEM Spiky_Evo3[] = {
  0xc0, 0x10, 0x70, 0x01, 0x60, 0xf0, 0x78, 0x01, 0x30, 0x80, 0x7f, 0xf7, 0x1b, 0xc0, 0xef, 0xfc, 
	0x0f, 0xc0, 0xc0, 0x18, 0x7f, 0xe0, 0xc0, 0x1c, 0x78, 0xe0, 0xc0, 0x18, 0x38, 0xf1, 0xc0, 0x38, 
	0x1c, 0x79, 0x80, 0x78, 0x1e, 0x3f, 0x80, 0x70, 0x37, 0x8f, 0x00, 0x61, 0xe3, 0xc7, 0x00, 0x73, 
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	0x2f, 0x73, 0x8f, 0x7f, 0x1e, 0x31, 0x06, 0x65, 0x3c, 0xe1, 0xe0, 0x26, 0x60, 0x82, 0x10, 0x32
};


Adafruit_SSD1306 display(128, 64, &Wire, -1);
Adafruit_MPU6050 mpu;

enum GameState {IDLE, CHOOSING, BATTLE, LOSE, WIN};
enum EvolutionState {BLOB, EVOLVING, BLOCKY1, BLOCKY2, BLOCKY3, SPIKY1, SPIKY2, SPIKY3};
GameState activeState = IDLE;
EvolutionState petState = BLOB;
int BattlesWon = 0;
int aiDifficulty = 1;
int defaultSquare = 4; // 4 is the center square in a game of tic tac toe, if you go 0 to 8.
char Board[9] = {' ', ' ', ' ', ' ', ' ', ' ', ' ', ' ', ' '};
bool isPlayerTurn = true;

unsigned long turnTimeLimit = 10000;
unsigned long TurnTimerStart = 0;

float currentTemperature = 24.0f;
unsigned long lastDHTReadTime = 0;

const uint8_t* getActivePetSprite() {
  switch(petState){
    case BLOCKY1: return Blocky_Evo1;
    case BLOCKY2: return Blocky_Evo2;
    case BLOCKY3: return Blocky_Evo3;
    case SPIKY1: return Spiky_Evo1;
    case SPIKY2: return Spiky_Evo2;
    case SPIKY3: return Spiky_Evo3;
    case BLOB:
    case CHOOSING:
    default:  return Blobb;
  }
}

//============================================================================
// AI (as in the bot, not that this is made by AI)
char checkWinCondition() {
  const int winPatterns[8][3] = {
    {0,1,2}, {3,4,5}, {6,7,8}, // Rows
    {0,3,6}, {1,4,7}, {2,5,8}, // Cols
    {0,4,8}, {2,4,6}           // Diagonals
  };
  for(int i = 0; i < 8; i++) {
    if(Board[winPatterns[i][0]] != ' ' &&
       Board[winPatterns[i][0]] == Board[winPatterns[i][1]] &&
       Board[winPatterns[i][0]] == Board[winPatterns[i][2]]) {
      return Board[winPatterns[i][0]];
    }
  }
  // Check for a tie match
  bool openSpotFound = false;
  for(int i = 0; i < 9; i++) { if(Board[i] == ' ') openSpotFound = true; }
  return openSpotFound ? ' ' : 'T';
}

void processBattleEnd(char winner) {
  if (winner == 'X') {
    BattlesWon++;
    aiDifficulty++;
    
    // Evaluate evolution gates
    if (petState == BLOB && BattlesWon >= 1) {
      activeState = CHOOSING;
    } 
    
    else if (petState == BLOCKY1 && BattlesWon >= 3) {
      petState = BLOCKY2;
      BattlesWon = 0;
      activeState = WIN;
    } else if (petState == BLOCKY2 && BattlesWon >= 5) {
      petState = BLOCKY3;
      BattlesWon = 0;
      activeState = WIN;
    }

    else if (petState == SPIKY1 && BattlesWon >= 3) {
      petState = SPIKY2;
      BattlesWon = 0;
      activeState = WIN;
    } else if (petState == SPIKY2 && BattlesWon >= 5) {
      petState = SPIKY3;
      BattlesWon = 0;
      activeState = WIN;

    } 
    else {
      activeState = WIN;
    }
  }
   else {
    activeState = LOSE;
  }
}

void executeBotMove() {
  if (activeState != BATTLE || isPlayerTurn) return;
  bool isSmartAI = false;
  if (petState == BLOCKY1 || petState == BLOCKY2 || petState == BLOCKY3) {
    isSmartAI = true; 
  } else if (aiDifficulty > 3) {
    isSmartAI = true; 
  }
  
  if (isSmartAI) {
    for(int i = 0; i < 9; i++) {
      if(Board[i] == ' ') {
        Board[i] = 'X'; 
        if(checkWinCondition() == 'X') { 
          Board[i] = 'O'; isPlayerTurn = true; TurnTimerStart = millis(); return; 
        }
        Board[i] = ' ';
      }
    }
  }
  for (int i = 0; i < 9; i++) {
    if (Board[i] == ' ') {
      Board[i] = 'O';
      isPlayerTurn = true;
      TurnTimerStart = millis();
      return;
    }
  }
}

void processTiltControls(float mpuX, float mpuY) {
  if (activeState != BATTLE || !isPlayerTurn) return;
  static unsigned long lastMove = 0;
  if (millis() - lastMove < 300) return; // Cursor step speed limiter

  int row = defaultSquare / 3; int col = defaultSquare % 3;
  if (mpuX > 2.5f && col < 2)  { col++; lastMove = millis(); }
  if (mpuX < -2.5f && col > 0) { col--; lastMove = millis(); }
  if (mpuY > 2.5f && row > 0)  { row--; lastMove = millis(); }
  if (mpuY < -2.5f && row < 2) { row++; lastMove = millis(); }
  defaultSquare = (row * 3) + col;
}

void drawGameBoard() {
  display.clearDisplay();
  
  // Draws the 3x3 Tic-Tac-Toe line boundaries on the left side of screen
  display.drawFastVLine(26, 0, 48, SSD1306_WHITE);
  display.drawFastVLine(46, 0, 48, SSD1306_WHITE);
  display.drawFastHLine(6, 16, 60, SSD1306_WHITE);
  display.drawFastHLine(6, 32, 60, SSD1306_WHITE);

  // Populates board cells with X and O text characters
  for (int i = 0; i < 9; i++) {
    int r = i / 3; int c = i % 3;
    int xPos = 13 + (c * 20); int yPos = 4 + (r * 16);
    
    if (Board[i] != ' ') {
      display.setCursor(xPos, yPos);
      display.print(Board[i]);
    }
    // Renders the active blinking selector frame over current cell
    if (i == defaultSquare && (millis() / 250) % 2 == 0) {
      display.drawRect(xPos - 4, yPos - 2, 14, 12, SSD1306_WHITE);
    }
  }

  // Renders the countdown timer bar at the very bottom
  long remaining = turnTimeLimit - (millis() - TurnTimerStart);
  if (remaining < 0) remaining = 0;
  int barWidth = map(remaining, 0, turnTimeLimit, 0, 128);
  display.fillRect(0, 58, barWidth, 4, SSD1306_WHITE);

  // Status interface panel data on the right half of the display screen
  display.setCursor(75, 4);  display.print("LVL: "); display.print(aiDifficulty);
  display.setCursor(75, 18); display.print(isPlayerTurn ? "YOUR" : "BOSS");
  display.setCursor(75, 28); display.print("TURN");
  display.display();
}

void displayBranchChoicePanel() {
  static bool choiceBlocky = true;
  display.clearDisplay();
  display.setCursor(0, 0); display.println("BOSS DEFEATED!\nCHOOSE YOUR BRANCH:");
  
  if (digitalRead(BUTTON_ONE_PIN) == LOW) { choiceBlocky = !choiceBlocky; delay(200); }

  display.setCursor(0, 24);
  display.println(choiceBlocky ? "> BLOCKY (+Time/-AI)" : "  BLOCKY (+Time/-AI)");
  display.println(!choiceBlocky ? "> SPIKY  (-Time/+AI)" : "  SPIKY  (-Time/+AI)");
  display.display();

  if (digitalRead(BUTTON_TWO_PIN) == LOW) {
    if (choiceBlocky) {
      petState = BLOCKY1; 
      if(isPlayingDemo) {
        turnTimeLimit = 160000; //its super hard to work with the wokwi gyroscope, so we'll give the player quadruple time if they're using it.
      }
      else{ turnTimeLimit = 40000;}
    } else {
      petState = SPIKY1;
      if(isPlayingDemo) {
        turnTimeLimit = 80000;
      }
      else{ turnTimeLimit = 20000;}
    }
    BattlesWon = 0; activeState = IDLE; delay(300);
  }
}


// ===========================================================================================
// setup and loop

void setup() {
  Serial.begin(115200);
  pinMode(BUTTON_ONE_PIN, INPUT_PULLUP);
  pinMode(BUTTON_TWO_PIN, INPUT_PULLUP);
  
  Wire.begin(I2C_SDA_PIN, I2C_SCL_PIN);
  display.begin(SSD1306_SWITCHCAPVCC, OLED_ADDRESS);
  mpu.begin(MPU6050_ADDRESS);
  
  display.clearDisplay();
  display.display();
}

void loop() {
  if (millis() - lastDHTReadTime >= 2000) {
    lastDHTReadTime = millis();
    float t = dht.readTemperature();
    if (!isnan(t)) {
      currentTemperature = t; // Live temperature tracking update
    }
  }

  sensors_event_t a, g, temp;
  mpu.getEvent(&a, &g, &temp);

  switch (activeState) {
    case CHOOSING:
      displayBranchChoicePanel();
      break;

    case BATTLE:
      processTiltControls(a.acceleration.x, a.acceleration.y);
      drawGameBoard();
      unsigned long activeTimeLimit = (currentTemperature > 29.0f || currentTemperature < 17.0f) ? (turnTimeLimit / 2) : turnTimeLimit;
      // Turn timer handling
      if (isPlayerTurn && (millis() - TurnTimerStart >= activeTimeLimit)) {
        processBattleEnd('O'); // Lose instantly if timer hits zero
      }
      
      // Confirm piece placement with Button 1
      if (isPlayerTurn && digitalRead(BUTTON_ONE_PIN) == LOW) {
        if (Board[defaultSquare] == ' ') {
          Board[defaultSquare] = 'X';
          char res = checkWinCondition();
          if (res != ' ') { processBattleEnd(res); } 
          else { isPlayerTurn = false; }
          delay(250);
        }
      }
      
      // Execute enemy move
      if (!isPlayerTurn) {
        delay(600); // Fakes the boss thinking loop
        executeBotMove();
        char res = checkWinCondition();
        if (res != ' ') { processBattleEnd(res); }
      }
      break;

    case LOSE:
      display.clearDisplay(); 
      display.setTextSize(1);
      display.setTextColor(SSD1306_WHITE);
      display.setCursor(10, 20); 
      display.println("YOU DIED. GAME OVER");
      display.setCursor(15, 44); 
      display.println("Press B1 to Reset"); 
      display.display();
      
      if (digitalRead(BUTTON_ONE_PIN) == LOW) { 
        petState = BLOB; 
        aiDifficulty = 1; 
        activeState = IDLE; 
        delay(300); 
      }
      break;

    case WIN:
      display.clearDisplay(); 
      display.setTextSize(1);
      display.setTextColor(SSD1306_WHITE);
      display.setCursor(15, 12); 
      display.println("VICTORY! EVOLVED!");
      display.drawBitmap(48, 28, getActivePetSprite(), 32, 32, SSD1306_WHITE); 
      display.display();
      delay(4000); 
      activeState = IDLE;
      break;

    case IDLE:
    default:
      display.clearDisplay();
      display.drawBitmap(48, 4, getActivePetSprite(), 32, 32, SSD1306_WHITE);
      display.setTextSize(1);
      display.setTextColor(SSD1306_WHITE);
      display.setCursor(0, 44); display.print("Wins: "); display.print(BattlesWon);
      display.setCursor(0, 54); display.print("Press B1 to Fight Boss"); 
      display.display();
      
      if (digitalRead(BUTTON_ONE_PIN) == LOW) {
        for(int i = 0; i < 9; i++) Board[i] = ' ';
        defaultSquare = 4; 
        isPlayerTurn = true; 
        TurnTimerStart = millis();
        activeState = BATTLE; 
        delay(300);
      }
      break;
  }
}
